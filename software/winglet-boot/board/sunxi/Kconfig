## software/winglet-os/winglet/uboot_defconfig
```kconfig
CONFIG_ARM=y
CONFIG_ARCH_SUNXI=y
CONFIG_DEFAULT_DEVICE_TREE="sun8i-t113s-winglet-$(WINGLET_BOARD_TYPE)-uboot"
CONFIG_SPL=y
CONFIG_IDENT_STRING=" winglet-os"
CONFIG_MACH_SUN8I_R528=y
CONFIG_DRAM_CLK=936
CONFIG_DRAM_ZQ=8092667
CONFIG_SUNXI_MINIMUM_DRAM_MB=128
CONFIG_MMC_SUNXI_SLOT_EXTRA=2
CONFIG_I2C_PROBE_ON_INIT=y
CONFIG_VIDEO_LCD_DCLK_PHASE=0
CONFIG_SUNXI_USES_WINGLET_SERIAL=y
CONFIG_SUNXI_WINGLET_MODEL_NAME_OFFSET=19
CONFIG_SYS_LOAD_ADDR=0x41000000
CONFIG_LOCALVERSION="-dcav"
CONFIG_ENV_VARS_UBOOT_CONFIG=y
# CONFIG_SYS_MALLOC_CLEAR_ON_INIT is not set
CONFIG_HAS_BOARD_SIZE_LIMIT=y
CONFIG_BOARD_SIZE_LIMIT=786432
# CONFIG_BOOTSTD is not set
CONFIG_SUPPORT_RAW_INITRD=y
# CONFIG_DISTRO_DEFAULTS is not set
CONFIG_BOOTDELAY=1
CONFIG_USE_BOOTCOMMAND=y
# CONFIG_CONSOLE_MUX is not set
CONFIG_SYS_STDIO_DEREGISTER=y
# CONFIG_SYS_DEVICE_NULLDEV is not set
CONFIG_LAST_STAGE_INIT=y
CONFIG_HUSH_PARSER=y
CONFIG_CMD_BOOTZ=y
# CONFIG_CMD_ELF is not set
# CONFIG_CMD_XIMG is not set
CONFIG_CMD_ERASEENV=y
CONFIG_CMD_NVEDIT_INFO=y
CONFIG_CMD_CLK=y
CONFIG_CMD_GPIO_READ=y
CONFIG_CMD_PWM=y
CONFIG_CMD_I2C=y
CONFIG_CMD_LSBLK=y
CONFIG_CMD_PART=y
CONFIG_CMD_USB_MASS_STORAGE=y
CONFIG_CMD_BMP=y
CONFIG_CMD_REGULATOR=y
CONFIG_CMD_EXT2=y
CONFIG_CMD_EXT4=y
CONFIG_CMD_FAT=y
CONFIG_CMD_FS_GENERIC=y
# CONFIG_CMD_CYCLIC is not set
CONFIG_ISO_PARTITION=y
# CONFIG_ENV_IS_IN_FAT is not set
CONFIG_ENV_IS_IN_EXT4=y
CONFIG_ENV_EXT4_INTERFACE="mmc"
CONFIG_ENV_EXT4_DEVICE_AND_PART=":2"
CONFIG_USE_DEFAULT_ENV_FILE=y
CONFIG_DEFAULT_ENV_FILE="$(PROJECT_VARIANT_DIR)/uboot.env"
# CONFIG_NET is not set
# CONFIG_USB_FUNCTION_FASTBOOT is not set
CONFIG_I2C_SET_DEFAULT_BUS_NUM=y
CONFIG_SYS_I2C_MVTWSI=y
CONFIG_SUPPORT_EMMC_BOOT=y
CONFIG_AXP2585_BMU=y
CONFIG_AXP2585_FAKE_PWROFF=y
CONFIG_AXP2585_FAKE_PWROFF_LOGO_PATH="$(PROJECT_VARIANT_DIR)/charging_logo.bmp"
CONFIG_AXP2585_BATT_LOW_LOGO_PATH="$(PROJECT_VARIANT_DIR)/batt_low.bmp"
CONFIG_DM_PWM=y
CONFIG_PWM_SUNXI=y
CONFIG_DRAM_SUNXI_ODT_EN=0
CONFIG_DRAM_SUNXI_TPR0=0x004a2195
CONFIG_DRAM_SUNXI_TPR11=0x340000
CONFIG_DRAM_SUNXI_TPR12=0x46
CONFIG_DRAM_SUNXI_TPR13=0x34000100
CONFIG_USB=y
CONFIG_USB_MUSB_GADGET=y
CONFIG_USB_GADGET_VBUS_DRAW=500
CONFIG_USB_GADGET_DOWNLOAD=y
CONFIG_VIDEO_LOGO_X=32767
CONFIG_VIDEO_LOGO_Y=32767
CONFIG_VIDEO_LOGO_PATH="$(PROJECT_VARIANT_DIR)/boot_logo.bmp"
CONFIG_BACKLIGHT_GPIO=y
# CONFIG_VIDEO_BPP8 is not set
CONFIG_VIDEO_LCD_SITRONIX_ST7701=y
# CONFIG_VIDEO_DT_SIMPLEFB is not set
CONFIG_BMP_16BPP=y
CONFIG_BMP_24BPP=y
CONFIG_BMP_32BPP=y
CONFIG_CIRCBUF=y
# CONFIG_EFI_LOADER is not set
```
