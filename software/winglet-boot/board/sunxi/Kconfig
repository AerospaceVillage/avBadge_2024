## software/winglet-boot/board/sunxi/Kconfig
```kconfig
choice
	prompt "SPL Image Type"
	default SPL_IMAGE_TYPE_SUNXI_EGON

config SPL_IMAGE_TYPE_SUNXI_EGON
	bool "eGON (normal)"
	help
	  Select this option to embed the SPL binary in an eGON.BT0 image,
	  which is compatible with the normal boot ROM (NBROM).

	  This is usually the correct option to choose.

config SPL_IMAGE_TYPE_SUNXI_TOC0
	bool "TOC0 (secure)"
	help
	  Select this option to embed the SPL binary in a TOC0 image,
	  which is compatible with the secure boot ROM (SBROM).

endchoice

config SUNXI_USES_WINGLET_SERIAL
	bool "Use Winglet Model/Serial Encoding"
	depends on MACH_SUN8I_R528
	select SPL_BOARD_INIT
	help
	  Set this to use the Winglet serial number encoding scheme,
	  where the board model/serial is encoded into the SID bank.

config SUNXI_WINGLET_MODEL_NAME_OFFSET
	int "Model Name offset in Device Tree Name String"
	depends on SUNXI_USES_WINGLET_SERIAL
	default 0
	help
	  The offset into the device tree name string that the '-model-' is
	  expected to be. This is how the model name, and thus model number
	  will be determined in SPL boot when verifying the correct board.

config SPL_IMAGE_TYPE
	string
	default "sunxi_egon" if SPL_IMAGE_TYPE_SUNXI_EGON
	default "sunxi_toc0" if SPL_IMAGE_TYPE_SUNXI_TOC0
```

## software/winglet-os/Config.in
```kconfig
# make the variant name available as a Config.in variable
#
# you can use BR2SM_PROJECT_NAME to have some options only appear for some variants
#
#config BR2SM_PROJECT_NAME
#	string
#	option env="PROJECT_NAME"
#

menu "Winglet OS Configuration"

config WINGLET_BOARD_TYPE
	string "Winglet Board Type"
	default bub
	help
		The board type to compile for this buildroot variant
		This should only be a temporary fix

config WINGLET_OS_VERSION
	string "Winglet OS Version"
	default 0.1
	help
		Version for this Winglet OS Build

endmenu

source "$BR2_EXTERNAL_WINGLET_OS_PATH/package/Config.in"
```

## software/winglet-os/package/Config.in
```kconfig
menu "Winglet Packages"
	source "$BR2_EXTERNAL_WINGLET_OS_PATH/package/dump1090-winglet/Config.in"
	source "$BR2_EXTERNAL_WINGLET_OS_PATH/package/led-daemon/Config.in"
	source "$BR2_EXTERNAL_WINGLET_OS_PATH/package/qtpbfimageplugin/Config.in"
	source "$BR2_EXTERNAL_WINGLET_OS_PATH/package/winglet-gui/Config.in"
endmenu
```

## software/winglet-os/package/dump1090-winglet/Config.in
```kconfig
config BR2_PACKAGE_DUMP1090_WINGLET
	bool "dump1090-winglet"
	depends on !BR2_PACKAGE_DUMP1090
	help
	  Dump 1090 is a Mode S decoder specifically designed for RTLSDR devices.
	  There are additional patches to enable this to support the DSP integrated in
	  the Aersoapce Village ADSB Badge that cannot be applied to the standard dump1090.

	  https://github.com/antirez/dump1090/
```

## software/winglet-os/package/led-daemon/Config.in
```kconfig
config BR2_PACKAGE_LED_DAEMON
	bool "led-daemon"
	help
		Winglet LED daemon

		https://www.aerospacevillage.org
```

## software/winglet-os/package/qtpbfimageplugin/Config.in
```kconfig
config BR2_PACKAGE_QTPBFIMAGEPLUGIN
	bool "QtPBFImagePlugin"
	depends on BR2_PACKAGE_QT5
	select BR2_PACKAGE_QT5BASE_WIDGETS
	help
		Qt PBF Image Plugin
```

## software/winglet-os/package/winglet-gui/Config.in
```kconfig
config BR2_PACKAGE_WINGLET_GUI
	bool "winglet-gui"
	depends on BR2_PACKAGE_QT5
	select BR2_PACKAGE_QT5BASE_WIDGETS
	help
		Badge UI package winglet-gui
		
		https://www.aerospacevillage.org
```

## software/winglet-os/winglet/defconfig
```kconfig
BR2_arm=y
BR2_cortex_a7=y
BR2_ARM_FPU_NEON_VFPV4=y
BR2_ARM_INSTRUCTIONS_THUMB2=y
BR2_TOOLCHAIN_BUILDROOT_VENDOR="dcav"
BR2_PACKAGE_GLIBC_UTILS=y
BR2_TOOLCHAIN_BUILDROOT_CXX=y
BR2_PACKAGE_HOST_GDB=y
BR2_PACKAGE_HOST_GDB_TUI=y
BR2_PACKAGE_HOST_GDB_PYTHON3=y
BR2_PACKAGE_OVERRIDE_FILE="$(PROJECT_VARIANT_DIR)/local.mk"
BR2_GLOBAL_PATCH_DIR="$(BR2_EXTERNAL)/patches"
BR2_TARGET_GENERIC_HOSTNAME="winglet"
BR2_TARGET_GENERIC_ISSUE="Winglet OS $(WINGLET_OS_VERSION) on \\l"
BR2_ROOTFS_DEVICE_CREATION_DYNAMIC_MDEV=y
# BR2_TARGET_GENERIC_REMOUNT_ROOTFS_RW is not set
BR2_TARGET_TZ_INFO=y
BR2_TARGET_LOCALTIME=""
BR2_ROOTFS_OVERLAY="$(PROJECT_VARIANT_DIR)/overlay"
BR2_ROOTFS_POST_BUILD_SCRIPT="$(BR2_EXTERNAL)/post-build.sh"
BR2_ROOTFS_POST_IMAGE_SCRIPT="$(BR2_EXTERNAL)/build-disk-image.sh"
BR2_ROOTFS_POST_SCRIPT_ARGS="$(WINGLET_OS_VERSION)"
BR2_LINUX_KERNEL=y
BR2_LINUX_KERNEL_CUSTOM_GIT=y
BR2_LINUX_KERNEL_CUSTOM_REPO_URL="git@github.com:AerospaceVillage/winglet-kernel.git"
BR2_LINUX_KERNEL_CUSTOM_REPO_VERSION="0e1a9b59fc9d4467730db1679c0d7002c20629d8"
BR2_LINUX_KERNEL_USE_CUSTOM_CONFIG=y
BR2_LINUX_KERNEL_CUSTOM_CONFIG_FILE="$(PROJECT_VARIANT_DIR)/linux_defconfig"
BR2_LINUX_KERNEL_DTS_SUPPORT=y
BR2_LINUX_KERNEL_CUSTOM_DTS_PATH="$(PROJECT_VARIANT_DIR)/sun8i-t113s-winglet-bub.dts $(PROJECT_VARIANT_DIR)/sun8i-t113s-winglet-dk.dts"
BR2_LINUX_KERNEL_INSTALL_TARGET=y
BR2_PACKAGE_BUSYBOX_CONFIG="$(PROJECT_VARIANT_DIR)/busybox.config"
BR2_PACKAGE_GSTREAMER1=y
BR2_PACKAGE_GST1_PLUGINS_BASE_INSTALL_TOOLS=y
BR2_PACKAGE_GST1_PLUGINS_BASE_PLUGIN_VIDEOTESTSRC=y
BR2_PACKAGE_GST1_PLUGINS_BASE_PLUGIN_OGG=y
BR2_PACKAGE_GST1_PLUGINS_GOOD=y
BR2_PACKAGE_GST1_PLUGINS_GOOD_JPEG=y
BR2_PACKAGE_GST1_PLUGINS_GOOD_PNG=y
BR2_PACKAGE_GST1_PLUGINS_GOOD_PLUGIN_AUTODETECT=y
BR2_PACKAGE_GST1_PLUGINS_GOOD_PLUGIN_VIDEOCROP=y
BR2_PACKAGE_GST1_PLUGINS_GOOD_PLUGIN_VIDEOFILTER=y
BR2_PACKAGE_GST1_PLUGINS_GOOD_PLUGIN_VIDEOMIXER=y
BR2_PACKAGE_GST1_PLUGINS_BAD=y
BR2_PACKAGE_GST1_PLUGINS_BAD_PLUGIN_AUTOCONVERT=y
BR2_PACKAGE_GST1_PLUGINS_BAD_PLUGIN_FBDEV=y
BR2_PACKAGE_GST1_PLUGINS_BAD_PLUGIN_KMS=y
BR2_PACKAGE_GST1_LIBAV=y
BR2_PACKAGE_V4L2GRAB=y
BR2_PACKAGE_GDB=y
BR2_PACKAGE_MEMSTAT=y
BR2_PACKAGE_STRACE=y
BR2_PACKAGE_STRESS_NG=y
BR2_PACKAGE_VALGRIND=y
BR2_PACKAGE_E2FSPROGS=y
BR2_PACKAGE_MMC_UTILS=y
BR2_PACKAGE_LIBERATION=y
BR2_PACKAGE_FB_TEST_APP=y
BR2_PACKAGE_FBGRAB=y
BR2_PACKAGE_FBV=y
BR2_PACKAGE_QT5=y
BR2_PACKAGE_QT5BASE_DEFAULT_QPA="linuxfb"
BR2_PACKAGE_QT5BASE_FONTCONFIG=y
BR2_PACKAGE_QT5BASE_GIF=y
BR2_PACKAGE_QT5BASE_JPEG=y
BR2_PACKAGE_QT5BASE_PNG=y
BR2_PACKAGE_QT5MULTIMEDIA=y
BR2_PACKAGE_QT5SVG=y
BR2_PACKAGE_QT5TOOLS=y
BR2_PACKAGE_QT5TOOLS_LINGUIST_TOOLS=y
BR2_PACKAGE_QT5TOOLS_QTDIAG=y
BR2_PACKAGE_EVTEST=y
BR2_PACKAGE_GPSD=y
BR2_PACKAGE_GPSD_DEVICES="/dev/gnss0"
BR2_PACKAGE_GPSD_USER=y
BR2_PACKAGE_GPSD_USER_VALUE="root"
BR2_PACKAGE_GPSD_GROUP=y
BR2_PACKAGE_GPSD_GROUP_VALUE="root"
BR2_PACKAGE_GPSD_PYTHON=y
BR2_PACKAGE_GPSD_UBX=y
BR2_PACKAGE_GPTFDISK=y
BR2_PACKAGE_GPTFDISK_GDISK=y
BR2_PACKAGE_GPTFDISK_SGDISK=y
BR2_PACKAGE_LSHW=y
BR2_PACKAGE_UBOOT_TOOLS=y
BR2_PACKAGE_UBOOT_TOOLS_MKENVIMAGE=y
BR2_PACKAGE_PYTHON3_CURSES=y
BR2_PACKAGE_PYTHON3_READLINE=y
BR2_PACKAGE_PYTHON_CANOPEN=y
BR2_PACKAGE_PYTHON_CERTIFI=y
BR2_PACKAGE_PYTHON_DATEUTIL=y
BR2_PACKAGE_PYTHON_EVDEV=y
BR2_PACKAGE_PYTHON_PIP=y
BR2_PACKAGE_PYTHON_PYBIND=y
BR2_PACKAGE_PYTHON_PYPARSING=y
BR2_PACKAGE_PYTHON_QRCODE=y
BR2_PACKAGE_PYTHON_QRCODE_PIL=y
BR2_PACKAGE_PYTHON_SMBUS_CFFI=y
BR2_PACKAGE_CA_CERTIFICATES=y
BR2_PACKAGE_NETTLE=y
BR2_PACKAGE_LIBOPENSSL_BIN=y
BR2_PACKAGE_LIBQRENCODE=y
BR2_PACKAGE_LIBQRENCODE_TOOLS=y
BR2_PACKAGE_LIBGPIOD=y
BR2_PACKAGE_LIBGPIOD_TOOLS=y
BR2_PACKAGE_LIBTASN1=y
BR2_PACKAGE_PROTOBUF=y
BR2_PACKAGE_QHULL=y
BR2_PACKAGE_LIBUNISTRING=y
BR2_PACKAGE_CAN_UTILS=y
BR2_PACKAGE_HOSTAPD=y
# BR2_PACKAGE_HOSTAPD_VLAN is not set
BR2_PACKAGE_IPROUTE2=y
BR2_PACKAGE_LRZSZ=y
BR2_PACKAGE_NTP=y
BR2_PACKAGE_NTP_SNTP=y
BR2_PACKAGE_NTP_NTP_SHM_CLK=y
BR2_PACKAGE_NTP_NTPD_ATOM_PPS=y
BR2_PACKAGE_NTP_NTPDC=y
BR2_PACKAGE_NTP_NTPQ=y
BR2_PACKAGE_OPENSSH=y
BR2_PACKAGE_RSYNC=y
BR2_PACKAGE_WPA_SUPPLICANT=y
BR2_PACKAGE_WPA_SUPPLICANT_CLI=y
BR2_PACKAGE_WPA_SUPPLICANT_WPA_CLIENT_SO=y
BR2_PACKAGE_WPA_SUPPLICANT_PASSPHRASE=y
BR2_PACKAGE_FILE=y
BR2_PACKAGE_SCREEN=y
BR2_PACKAGE_ACL=y
BR2_PACKAGE_HTOP=y
BR2_PACKAGE_UTIL_LINUX_BINARIES=y
BR2_PACKAGE_UTIL_LINUX_RFKILL=y
BR2_PACKAGE_UTIL_LINUX_SETTERM=y
BR2_PACKAGE_UTIL_LINUX_WAITPID=y
BR2_PACKAGE_NANO=y
BR2_TARGET_ROOTFS_EXT2=y
BR2_TARGET_ROOTFS_EXT2_LABEL="winglet-rootfs"
BR2_TARGET_ROOTFS_EXT2_SIZE="1G"
BR2_TARGET_ROOTFS_EXT2_INODES=131072
# BR2_TARGET_ROOTFS_TAR is not set
BR2_TARGET_UBOOT=y
BR2_TARGET_UBOOT_BUILD_SYSTEM_KCONFIG=y
BR2_TARGET_UBOOT_CUSTOM_GIT=y
BR2_TARGET_UBOOT_CUSTOM_REPO_URL="git@github.com:AerospaceVillage/winglet-boot.git"
BR2_TARGET_UBOOT_CUSTOM_REPO_VERSION="a50fe3368b1dfa98f361d54e5f2efa725f677a92"
BR2_TARGET_UBOOT_USE_CUSTOM_CONFIG=y
BR2_TARGET_UBOOT_CUSTOM_CONFIG_FILE="$(PROJECT_VARIANT_DIR)/uboot_defconfig"
# BR2_TARGET_UBOOT_FORMAT_BIN is not set
BR2_TARGET_UBOOT_FORMAT_CUSTOM=y
BR2_TARGET_UBOOT_FORMAT_CUSTOM_NAME="u-boot-sunxi-with-spl.bin"
BR2_TARGET_UBOOT_CUSTOM_DTS_PATH="$(PROJECT_VARIANT_DIR)/sun8i-t113s-winglet-bub-uboot.dts $(PROJECT_VARIANT_DIR)/sun8i-t113s-winglet-dk-uboot.dts"
BR2_TARGET_UBOOT_CUSTOM_MAKEOPTS="PROJECT_VARIANT_DIR=$(PROJECT_VARIANT_DIR) WINGLET_BOARD_TYPE=$(WINGLET_BOARD_TYPE)"
BR2_PACKAGE_HOST_SWIG=y
BR2_PACKAGE_HOST_UBOOT_TOOLS=y
WINGLET_BOARD_TYPE="dk"
WINGLET_OS_VERSION="1.1"
BR2_PACKAGE_WINGLET_GUI=y
BR2_PACKAGE_QTPBFIMAGEPLUGIN=y
BR2_PACKAGE_DUMP1090_WINGLET=y
```

## software/winglet-os/winglet/linux_defconfig
```kconfig
CONFIG_LOCALVERSION="-winglet"
CONFIG_DEFAULT_HOSTNAME="winglet"
CONFIG_SYSVIPC=y
CONFIG_POSIX_MQUEUE=y
CONFIG_WATCH_QUEUE=y
CONFIG_NO_HZ_IDLE=y
CONFIG_HIGH_RES_TIMERS=y
CONFIG_PREEMPT=y
CONFIG_IKCONFIG=y
CONFIG_IKCONFIG_PROC=y
CONFIG_CGROUPS=y
CONFIG_PERF_EVENTS=y
CONFIG_ARCH_SUNXI=y
CONFIG_SMP=y
CONFIG_NR_CPUS=8
CONFIG_THUMB2_KERNEL=y
CONFIG_HIGHMEM=y
# CONFIG_ATAGS is not set
CONFIG_CPU_FREQ=y
CONFIG_CPUFREQ_DT=y
CONFIG_VFP=y
CONFIG_NEON=y
CONFIG_JUMP_LABEL=y
# CONFIG_GCC_PLUGINS is not set
CONFIG_MODULES=y
CONFIG_MODULE_UNLOAD=y
CONFIG_CMA=y
CONFIG_NET=y
CONFIG_PACKET=y
CONFIG_UNIX=y
CONFIG_INET=y
CONFIG_IP_PNP=y
CONFIG_IP_PNP_DHCP=y
CONFIG_IP_PNP_BOOTP=y
# CONFIG_INET_DIAG is not set
# CONFIG_IPV6 is not set
CONFIG_CAN=m
CONFIG_CAN_J1939=m
CONFIG_CAN_ISOTP=m
CONFIG_CFG80211=m
CONFIG_MAC80211=m
CONFIG_RFKILL=y
CONFIG_UEVENT_HELPER=y
CONFIG_UEVENT_HELPER_PATH="/sbin/mdev"
CONFIG_DEVTMPFS=y
CONFIG_DEVTMPFS_MOUNT=y
CONFIG_SUNXI_DSP=y
CONFIG_GNSS=m
CONFIG_GNSS_UBX_SERIAL=m
CONFIG_BLK_DEV_LOOP=y
CONFIG_BLK_DEV_SD=y
CONFIG_ATA=y
CONFIG_AHCI_SUNXI=y
CONFIG_NETDEVICES=y
CONFIG_SUN4I_EMAC=y
# CONFIG_NET_VENDOR_ARC is not set
# CONFIG_NET_VENDOR_BROADCOM is not set
# CONFIG_NET_VENDOR_CIRRUS is not set
# CONFIG_NET_VENDOR_FARADAY is not set
# CONFIG_NET_VENDOR_INTEL is not set
# CONFIG_NET_VENDOR_MARVELL is not set
# CONFIG_NET_VENDOR_MICREL is not set
# CONFIG_NET_VENDOR_MICROCHIP is not set
# CONFIG_NET_VENDOR_NATSEMI is not set
# CONFIG_NET_VENDOR_SAMSUNG is not set
# CONFIG_NET_VENDOR_SEEQ is not set
# CONFIG_NET_VENDOR_SMSC is not set
CONFIG_STMMAC_ETH=y
# CONFIG_NET_VENDOR_VIA is not set
# CONFIG_NET_VENDOR_WIZNET is not set
CONFIG_MICREL_PHY=y
CONFIG_REALTEK_PHY=y
CONFIG_CAN_SUN4I=m
CONFIG_HOSTAP=m
CONFIG_RTL8XXXU=m
CONFIG_RTL8XXXU_UNTESTED=y
CONFIG_INPUT_EVDEV=y
CONFIG_KEYBOARD_ADC=y
CONFIG_KEYBOARD_GPIO=y
# CONFIG_INPUT_MOUSE is not set
CONFIG_INPUT_JOYSTICK=y
CONFIG_JOYSTICK_XPAD=m
CONFIG_JOYSTICK_XPAD_FF=y
CONFIG_JOYSTICK_XPAD_LEDS=y
CONFIG_INPUT_TOUCHSCREEN=y
CONFIG_TOUCHSCREEN_SUN4I=y
CONFIG_INPUT_MISC=y
CONFIG_INPUT_AXP2101_PEK=y
CONFIG_INPUT_GPIO_ROTARY_ENCODER=y
CONFIG_SERIO_SUN4I_PS2=y
# CONFIG_LEGACY_PTYS is not set
CONFIG_SERIAL_8250=y
# CONFIG_SERIAL_8250_DEPRECATED_OPTIONS is not set
CONFIG_SERIAL_8250_CONSOLE=y
CONFIG_SERIAL_8250_NR_UARTS=8
CONFIG_SERIAL_8250_RUNTIME_UARTS=6
CONFIG_SERIAL_8250_DW=y
CONFIG_SERIAL_OF_PLATFORM=y
CONFIG_SERIAL_DEV_BUS=y
CONFIG_WINGLET_ADSB_RX=y
CONFIG_I2C_CHARDEV=y
CONFIG_I2C_MV64XXX=y
CONFIG_I2C_SUN6I_P2WI=y
CONFIG_SPI=y
CONFIG_SPI_SUN4I=y
CONFIG_SPI_SUN6I=y
CONFIG_POWER_SUPPLY=y
CONFIG_AXP2585_POWER=y
CONFIG_THERMAL=y
CONFIG_CPU_THERMAL=y
CONFIG_SUN8I_THERMAL=y
CONFIG_WATCHDOG=y
CONFIG_SUNXI_WATCHDOG=y
CONFIG_MFD_AC100=y
CONFIG_MFD_AXP2101_I2C=y
CONFIG_REGULATOR=y
CONFIG_REGULATOR_FIXED_VOLTAGE=y
CONFIG_REGULATOR_AXP2101=y
CONFIG_REGULATOR_GPIO=y
CONFIG_MEDIA_SUPPORT=y
CONFIG_MEDIA_PLATFORM_SUPPORT=y
CONFIG_V4L_PLATFORM_DRIVERS=y
CONFIG_V4L_MEM2MEM_DRIVERS=y
CONFIG_VIDEO_SUN4I_CSI=y
CONFIG_VIDEO_SUN6I_CSI=y
CONFIG_VIDEO_SUN8I_DEINTERLACE=y
CONFIG_VIDEO_SUN8I_ROTATE=y
CONFIG_DRM=y
CONFIG_DRM_FBDEV_EMULATION=y
CONFIG_DRM_FBDEV_OVERALLOC=200
CONFIG_DRM_SUN4I=y
# CONFIG_DRM_SUN4I_HDMI is not set
# CONFIG_DRM_SUN4I_BACKEND is not set
# CONFIG_DRM_SUN6I_DSI is not set
# CONFIG_DRM_SUN8I_DW_HDMI is not set
CONFIG_DRM_PANEL_LVDS=y
CONFIG_DRM_PANEL_SIMPLE=y
CONFIG_DRM_PANEL_EDP=y
CONFIG_DRM_SIMPLE_BRIDGE=y
CONFIG_FB_DEVICE=y
CONFIG_BACKLIGHT_CLASS_DEVICE=y
CONFIG_BACKLIGHT_PWM=y
CONFIG_LOGO=y
# CONFIG_LOGO_LINUX_MONO is not set
# CONFIG_LOGO_LINUX_VGA16 is not set
CONFIG_SOUND=y
CONFIG_SND=y
CONFIG_SND_SOC=y
CONFIG_SND_SUN4I_CODEC=y
CONFIG_SND_SUN8I_CODEC=y
CONFIG_SND_SUN8I_CODEC_ANALOG=y
CONFIG_SND_SUN4I_I2S=y
CONFIG_SND_SUN4I_SPDIF=y
CONFIG_USB=y
CONFIG_USB_EHCI_HCD=y
CONFIG_USB_EHCI_HCD_PLATFORM=y
CONFIG_USB_OHCI_HCD=y
CONFIG_USB_OHCI_HCD_PLATFORM=y
CONFIG_USB_STORAGE=m
CONFIG_USB_UAS=m
CONFIG_USB_MUSB_HDRC=y
CONFIG_USB_MUSB_SUNXI=y
CONFIG_NOP_USB_XCEIV=y
CONFIG_USB_GADGET=y
CONFIG_USB_GADGET_VBUS_DRAW=500
CONFIG_USB_ETH=m
CONFIG_MMC=y
CONFIG_MMC_SUNXI=y
CONFIG_NEW_LEDS=y
CONFIG_LEDS_CLASS=y
CONFIG_LEDS_SUNXI=y
CONFIG_LEDS_GPIO=y
CONFIG_LEDS_TRIGGERS=y
CONFIG_LEDS_TRIGGER_HEARTBEAT=y
CONFIG_LEDS_TRIGGER_DEFAULT_ON=y
CONFIG_RTC_CLASS=y
# CONFIG_RTC_INTF_SYSFS is not set
# CONFIG_RTC_INTF_PROC is not set
CONFIG_RTC_DRV_AC100=y
CONFIG_RTC_DRV_SUNXI=y
CONFIG_DMADEVICES=y
CONFIG_DMA_SUN6I=y
CONFIG_STAGING=y
CONFIG_STAGING_MEDIA=y
CONFIG_VIDEO_SUNXI=y
CONFIG_VIDEO_SUNXI_CEDRUS=y
CONFIG_MAILBOX=y
# CONFIG_IOMMU_SUPPORT is not set
CONFIG_PM_DEVFREQ=y
CONFIG_DEVFREQ_GOV_SIMPLE_ONDEMAND=y
CONFIG_IIO=y
CONFIG_SUN20I_GPADC=y
CONFIG_PWM=y
CONFIG_PWM_SUNXI_GROUP=y
CONFIG_PHY_SUN4I_USB=y
CONFIG_PHY_SUN9I_USB=y
CONFIG_NVMEM_SUNXI_SID=y
CONFIG_EXT4_FS=y
CONFIG_MSDOS_FS=m
CONFIG_VFAT_FS=y
CONFIG_EXFAT_FS=m
CONFIG_NTFS_FS=m
CONFIG_NTFS3_FS=m
CONFIG_TMPFS=y
CONFIG_NFS_FS=y
CONFIG_NFS_V3_ACL=y
CONFIG_NFS_V4=y
CONFIG_ROOT_NFS=y
CONFIG_NLS_CODEPAGE_437=y
CONFIG_NLS_ISO8859_1=y
CONFIG_CRYPTO_DEV_SUN8I_CE=y
CONFIG_CRYPTO_DEV_SUN8I_CE_HASH=y
CONFIG_CRYPTO_DEV_SUN8I_CE_PRNG=y
CONFIG_CRYPTO_DEV_SUN8I_CE_TRNG=y
CONFIG_CRC_CCITT=y
CONFIG_XZ_DEC=y
CONFIG_DMA_CMA=y
CONFIG_FONTS=y
CONFIG_FONT_8x16=y
CONFIG_FONT_7x14=y
CONFIG_FONT_6x10=y
CONFIG_PRINTK_TIME=y
CONFIG_DEBUG_FS=y
```
